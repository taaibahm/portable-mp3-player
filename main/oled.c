#include <string.h>
#include "oled.h"
#include "esp_log.h"
#include "driver/i2c_master.h"

#define TAG "OLED"

#define OLED_WIDTH  128
#define OLED_HEIGHT 64
#define OLED_PAGES  (OLED_HEIGHT / 8)

// 0 for SSD1306, 2 for SH1106. Many 1.3" modules sold as SSD1306 (including
// ours) are actually SH1106, which has 132 columns of RAM with the visible 128
// in the middle. The wrong value cuts off the left edge and leaves a strip of
// noise on the right.
#define OLED_COL_OFFSET 2

#define OLED_I2C_FREQ_HZ 400000
#define OLED_TIMEOUT_MS  100

#define OLED_CTRL_CMD  0x00
#define OLED_CTRL_DATA 0x40

static i2c_master_dev_handle_t oled_dev;
static uint8_t framebuffer[OLED_PAGES][OLED_WIDTH];

// Classic 5x7 font, ASCII 0x20-0x7E, one byte per column (LSB at the top)
static const uint8_t font5x7[][5] = {
    {0x00, 0x00, 0x00, 0x00, 0x00}, // ' '
    {0x00, 0x00, 0x5F, 0x00, 0x00}, // !
    {0x00, 0x07, 0x00, 0x07, 0x00}, // "
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    {0x02, 0x01, 0x02, 0x04, 0x02}, // ~
};

static const uint8_t init_cmds[] = {
    OLED_CTRL_CMD,
    0xAE,       // Display off
    0xD5, 0x80, // Clock divide ratio / oscillator frequency
    0xA8, 0x3F, // Multiplex ratio: 64 rows
    0xD3, 0x00, // Display offset: none
    0x40,       // Start line 0
    0x8D, 0x14, // Enable charge pump (SSD1306)
    0xA1,       // Flip horizontally (column 127 mapped to SEG0)
    0xC8,       // Flip vertically (scan COM63 to COM0)
    0xDA, 0x12, // COM pins configuration for 128x64
    0x81, 0xCF, // Contrast
    0xD9, 0xF1, // Pre-charge period
    0xDB, 0x40, // VCOMH deselect level
    0xA4,       // Show RAM contents
    0xA6,       // Normal (not inverted)
    0xAF,       // Display on
};

esp_err_t oled_init(int sda_gpio, int scl_gpio) {
    i2c_master_bus_config_t bus_cfg = {
        .i2c_port = I2C_NUM_0,
        .sda_io_num = sda_gpio,
        .scl_io_num = scl_gpio,
        .clk_source = I2C_CLK_SRC_DEFAULT,
        .glitch_ignore_cnt = 7,
        .flags.enable_internal_pullup = true,
    };
    i2c_master_bus_handle_t bus;
    esp_err_t ret = i2c_new_master_bus(&bus_cfg, &bus);
    if (ret != ESP_OK) {
        ESP_LOGE(TAG, "Failed to create I2C bus: %s", esp_err_to_name(ret));
        return ret;
    }

    // Most modules use 0x3C; some have a solder jumper that switches to 0x3D
    uint16_t addr;
    if (i2c_master_probe(bus, 0x3C, OLED_TIMEOUT_MS) == ESP_OK) {
        addr = 0x3C;
    } else if (i2c_master_probe(bus, 0x3D, OLED_TIMEOUT_MS) == ESP_OK) {
        addr = 0x3D;
    } else {
        ESP_LOGE(TAG, "No display found at 0x3C or 0x3D, check wiring (SDA GPIO %d, SCL GPIO %d)",
                 sda_gpio, scl_gpio);
        i2c_del_master_bus(bus);
        return ESP_ERR_NOT_FOUND;
    }

    i2c_device_config_t dev_cfg = {
        .dev_addr_length = I2C_ADDR_BIT_LEN_7,
        .device_address = addr,
        .scl_speed_hz = OLED_I2C_FREQ_HZ,
    };
    ret = i2c_master_bus_add_device(bus, &dev_cfg, &oled_dev);
    if (ret != ESP_OK) {
        ESP_LOGE(TAG, "Failed to add I2C device: %s", esp_err_to_name(ret));
        return ret;
    }

    ret = i2c_master_transmit(oled_dev, init_cmds, sizeof(init_cmds), OLED_TIMEOUT_MS);
    if (ret != ESP_OK) {
        ESP_LOGE(TAG, "Failed to send init commands: %s", esp_err_to_name(ret));
        return ret;
    }

    ESP_LOGI(TAG, "Display found at 0x%02X", addr);
    oled_clear();
    return oled_flush();
}

void oled_clear(void) {
    memset(framebuffer, 0, sizeof(framebuffer));
}

void oled_draw_string(int x, int row, const char *text) {
    if (row < 0 || row >= OLED_PAGES) {
        return;
    }

    for (; *text && x < OLED_WIDTH; text++, x += 6) {
        char c = *text;
        if (c < 0x20 || c > 0x7E) {
            c = '?';
        }
        const uint8_t *glyph = font5x7[c - 0x20];

        // 5 glyph columns plus 1 blank column of spacing
        for (int i = 0; i < 6 && x + i < OLED_WIDTH; i++) {
            if (x + i >= 0) {
                framebuffer[row][x + i] = i < 5 ? glyph[i] : 0;
            }
        }
    }
}

esp_err_t oled_flush(void) {
    // Lets callers keep drawing (to the framebuffer only) when no display was found
    if (oled_dev == NULL) {
        return ESP_ERR_INVALID_STATE;
    }

    uint8_t data[1 + OLED_WIDTH];
    data[0] = OLED_CTRL_DATA;

    // Page addressing mode (the reset default) works on both SSD1306 and SH1106
    for (int page = 0; page < OLED_PAGES; page++) {
        uint8_t cmds[] = {
            OLED_CTRL_CMD,
            0xB0 | page,                            // Page address
            0x00 | (OLED_COL_OFFSET & 0x0F),        // Column address, low nibble
            0x10 | ((OLED_COL_OFFSET >> 4) & 0x0F), // Column address, high nibble
        };
        esp_err_t ret = i2c_master_transmit(oled_dev, cmds, sizeof(cmds), OLED_TIMEOUT_MS);
        if (ret != ESP_OK) {
            return ret;
        }

        memcpy(&data[1], framebuffer[page], OLED_WIDTH);
        ret = i2c_master_transmit(oled_dev, data, sizeof(data), OLED_TIMEOUT_MS);
        if (ret != ESP_OK) {
            return ret;
        }
    }
    return ESP_OK;
}
